## boards/shields/toucan/Kconfig.shield
```kconfig
config SHIELD_TOUCAN_LEFT
    def_bool $(shields_list_contains,toucan_left)

config SHIELD_TOUCAN_RIGHT
    def_bool $(shields_list_contains,toucan_right)

config TOUCAN_HEARTBEAT
    bool "Toucan diagnostic heartbeat"
    depends on PRINTK
    default n
    help
      Spawns a dedicated thread that prints a 1Hz heartbeat with an
      embedded system-workqueue liveness counter. Used to diagnose
      right-half freezes: distinguishes a wedged MCU (heartbeat stops)
      from a stalled system workqueue (heartbeat ticks but the wq
      counter stops advancing). Pair with the zmk-usb-logging snippet
      so output reaches USB CDC.
```

## dts/bindings/behaviors/toucan,behavior-caps-word.yaml
```yaml
# Copyright (c) 2026 The Toucan Contributors
# SPDX-License-Identifier: MIT

description: Toucan Caps Word behavior with state-change events

compatible: "toucan,behavior-caps-word"

include: zero_param.yaml

properties:
  continue-list:
    type: array
    required: true
```
